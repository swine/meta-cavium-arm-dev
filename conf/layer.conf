## conf/layer.conf
```bitbake
# We have a conf and classes directory, add to BBPATH
BBPATH := "${LAYERDIR}:${BBPATH}"
FILESPATH = "${FILE_DIRNAME}/${PF}:${FILE_DIRNAME}/${P}:\
${FILE_DIRNAME}/${PN}:${FILE_DIRNAME}/files:${FILE_DIRNAME} ${LAYERDIR}/recipes-devtools/gdb/gdb"
BBPATH .= ":${LAYERDIR}"
BBFILES += "\
            ${LAYERDIR}/recipes-*/*/*.bb \
            ${LAYERDIR}/recipes-*/*/*.bbappend \
           "


#BBFILES += "${BBFILES} ${LAYERDIR}/recipes/*/*.bb ${LAYERDIR}/recipes*/*/*.bb"
#BBFILES += "${BBFILES} ${LAYERDIR}/recipes/*/*.bbappend ${LAYERDIR}/recipes*/*/*.bbappend"
BBFILE_COLLECTIONS += "cavium"
BBFILE_PATTERN_cavium = "^${LAYERDIR}/"
BBFILE_PRIORITY_cavium = "5"

#DISTRO = "openwrt"
```

## conf/machine/cavium-thunderx-81xx.conf
```bitbake
#@TYPE: Machine
#@NAME: Cavium ThunderX 88xx

include conf/machine/genericarmv8-ilp32.conf
#
SERIAL_CONSOLES = "115200;ttyAMA0"

PREFERRED_PROVIDER_virtual/kernel ??= "linux-thunderx-81xx"
PREFERRED_VERSION_linux-yocto ??= "4.6"

KERNEL_IMAGETYPE = "Image"
KERNEL_DEVICETREE = "cavium/thunder-81xx.dtb"
SERIAL_CONSOLES_CHECK ?= "${SERIAL_CONSOLES}"
IMAGE_FSTYPES = " ext4 cpio.gz tar.gz"

MACHINE_FEATURES_append = "pci ext2 serial usbhost vfat "
```

## recipes-core/images/files/81xx.its
```
/dts-v1/;

/ {
        description = "Image file for the 81xx Linux Kernel";
        #address-cells = <0x1>;
        images {

                kernel@1 {

                        description = "ARM64 Linux kernel";
                        data = /incbin/("81XX_KERNEL_IMG");
                        type = "kernel";
                        arch = "arm64";
                        os = "linux";
                        compression = "none";
                        load = <0x50080000>;
                        entry = <0x50080000>;
                };
                fdt@1 {

                        description = "Flattened Device Tree blob";
                        data = /incbin/("81XX_DTB");
                        type = "flat_dt";
                        arch = "arm64";
                        compression = "none";
                        load = <0x4f000000>;
                        entry = <0x4f000000>;
                };
                ramdisk@1 {

                        description = "81xx Ramdisk";
                        data = /incbin/("81XX_ROOTFS_EXT4");
                        type = "ramdisk";
                        arch = "arm64";
                        os = "linux";
                        compression = "none";
                        load = <0x40000000>;
                        entry = <0x40000000>;
                };
        };

        configurations {
                default = "config@1";
                config@1 {
                        description = "Boot Linux kernel";
                        kernel = "kernel@1";
                        fdt = "fdt@1";
                        ramdisk = "ramdisk@1";
                };
        };

};
```
